/*
 * Halcyon Ferris keymap — ported from the Corneish Zen v2 `tospens-experimental`
 * config (zmk-config-zen-2), adapted for 34 keys / 2 thumbs per side instead
 * of the Zen's 36 keys / 3 thumbs per side.
 *
 * num_word and magic_shift are implemented with the real upstream modules
 * from urob/zmk-config (zmk-auto-layer, zmk-adaptive-key) rather than
 * tospens-experimental's hand-rolled tap-dance/mod-morph approximations.
 */

#include <behaviors.dtsi>
#include <behaviors/num_word.dtsi> // zmk-auto-layer module
#include <dt-bindings/zmk/bt.h>
#include <dt-bindings/zmk/keys.h>
#include <dt-bindings/zmk/pointing.h>

#include <zmk-helpers/helper.h>
#include <zmk-helpers/key-labels/34.h> // provides KEYS_L/KEYS_R/THUMBS_L/THUMBS_R/THUMBS
#include <zmk-helpers/unicode-chars/danish.dtsi>

/* Layer aliases */

#define BASE 0
#define NAV 1
#define NUM 2
#define FN 3
#define SYS 4
#define MOUSE 5

#include "combos.dtsi"
#include "mouse.dtsi"

ZMK_CONDITIONAL_LAYER(sys, FN NUM, SYS) // FN + NUM --> SYS

/* Settings */

#define QUICK_TAP_MS 175

&lt { // layer-tap config
    flavor = "balanced";
    tapping-term-ms = <200>;
    quick-tap-ms = <QUICK_TAP_MS>;
};

&mt { // tap-preferred mod-tap config
    flavor = "tap-preferred";
    tapping-term-ms = <220>;
    quick-tap-ms = <220>;              // repeat on tap-into-hold
    hold-trigger-key-positions = <0>;  // tap on interrupt
};

#define NAV_LEFT  &mt HOME     LEFT    // tap: left  | long-tap: beginning of line
#define NAV_RIGHT &mt END      RIGHT   // tap: right | long-tap: end       of line
#define NAV_UP    &mt LC(HOME) UP      // tap: up    | long-tap: beginning of document
#define NAV_DOWN  &mt LC(END)  DOWN    // tap: down  | long-tap: end       of document
#define NAV_BSPC  &mt LC(BSPC) BSPC    // tap: bspc  | long-tap: delete word backward
#define NAV_DEL   &mt LC(DEL)  DEL     // tap: del   | long-tap: delete word forward

#define CANCEL      &kp K_CANCEL             // cancel caps-word and num-word
#define DSK_PREV    &hmr RSHFT LG(LC(LEFT))  // previous desktop
#define DSK_NEXT    &hmr LALT LG(LC(RIGHT))  // next     desktop
#define VOL_DOWN    &hmr LCTRL C_VOL_DN

// Clipboard keycodes.
#define U_RDO LC(Y)
#define U_PST LC(V)
#define U_CPY LC(C)
#define U_CUT LC(X)
#define U_UND LC(Z)

// Window management keycodes.
#define U_SLFT LG(LS(LEFT))
#define U_SRGT LG(LS(RIGHT))
#define U_DRGT LG(LC(RIGHT))
#define U_DLFT LG(LC(LEFT))
#define U_DSHW LG(TAB)

// Misc
#define U_PSCR LC(PSCRN)

/* Halcyon extras — used at the end of every layer below */

// Extra key row provided by the Halcyon controller (halcyon_transform row 4:
// 5 direct-GPIO inputs per side, separate from the 34-key matrix). The outermost
// position on each side is the mod_encoder push button; the other positions are
// not wired to any module fitted on this build.
//
// Arguments are the left and right encoder push-button bindings.
#define HALCYON_KEYS(left_press, right_press) \
    left_press &none &none &none &none   &none &none &none &none right_press

// Encoder rotation (passed to ZMK_LAYER as its sensor-bindings argument).
// Each entry is <left encoder> <right encoder>; inc_dec_kp takes clockwise first.
// left = volume on every layer. right = undo/redo by default, with overrides below.
#define SENSORS       &inc_dec_kp C_VOL_UP C_VOL_DN &inc_dec_kp U_RDO U_UND    // right: CW redo, CCW undo
#define SENSORS_FN    &inc_dec_kp C_VOL_UP C_VOL_DN &inc_dec_kp C_VOL_UP C_VOL_DN // right: volume
#define SENSORS_MOUSE &inc_dec_kp C_VOL_UP C_VOL_DN &scroll_encoder            // right: mouse wheel (mouse.dtsi)

/* Homerow mods */

ZMK_HOLD_TAP(hml, // left-hand HRMs
    flavor = "balanced";
    tapping-term-ms = <280>;
    quick-tap-ms = <QUICK_TAP_MS>;
    require-prior-idle-ms = <150>;      // modern name for the Zen fork's global-quick-tap-ms (PR #1387, merged upstream)
    bindings = <&kp>, <&kp>;
    hold-trigger-key-positions = <KEYS_R THUMBS>;
    hold-trigger-on-release;
)

ZMK_HOLD_TAP(hmr, // right-hand HRMs
    flavor = "balanced";
    tapping-term-ms = <280>;
    quick-tap-ms = <QUICK_TAP_MS>;
    require-prior-idle-ms = <150>;
    bindings = <&kp>, <&kp>;
    hold-trigger-key-positions = <KEYS_L THUMBS>;
    hold-trigger-on-release;
)

/* Custom behaviors */

ZMK_MACRO(cblck,
    wait-ms = <10>;
    tap-ms = <20>;
    bindings = <&kp GRAVE &kp GRAVE &kp GRAVE>;
)
ZMK_MACRO(dblbrc,
    wait-ms = <10>;
    tap-ms = <20>;
    bindings = <&kp LBRC &kp RBRC>, <&kp LEFT>;
)
ZMK_MACRO(dblpar,
    wait-ms = <10>;
    tap-ms = <20>;
    bindings = <&kp LPAR &kp RPAR>, <&kp LEFT>;
)
ZMK_MACRO(dblbkt,
    wait-ms = <10>;
    tap-ms = <20>;
    bindings = <&kp LBKT &kp RBKT>, <&kp LEFT>;
)
ZMK_MACRO(dblang,
    wait-ms = <10>;
    tap-ms = <20>;
    bindings = <&kp LT &kp GT>, <&kp LEFT>;
)
ZMK_MACRO(winleft,
    wait-ms = <10>;
    tap-ms = <20>;
    bindings
    = <&macro_press   &kp LGUI>
    , <&macro_tap     &kp LEFT>
    , <&macro_release &kp LGUI>
    ;
)
ZMK_MACRO(winrght,
    wait-ms = <10>;
    tap-ms = <20>;
    bindings
    = <&macro_press   &kp LGUI>
    , <&macro_tap     &kp RIGHT>
    , <&macro_release &kp LGUI>
    ;
)
ZMK_MACRO(winup,
    wait-ms = <10>;
    tap-ms = <20>;
    bindings
    = <&macro_press   &kp LGUI>
    , <&macro_tap     &kp UP>
    , <&macro_release &kp LGUI>
    ;
)
// Select word. First press selects the word under the cursor; each further press
// extends by one word (LEFT extends backwards). Ctrl+Shift stay held until the
// tri-state ends, so the arrow keys move the selection by whole words.
// The tri-state's continue binding also fires on the first press, so the start
// macro only positions the cursor and turns the mods on; the first RIGHT selects.
ZMK_MACRO(selword_start,
    wait-ms = <10>;
    tap-ms = <20>;
    bindings = <&kt LCTRL>, <&kp RIGHT>, <&kp LEFT>, <&kt LSHFT>;
)
ZMK_MACRO(selword_end,
    wait-ms = <10>;
    tap-ms = <20>;
    bindings = <&kt LSHFT>, <&kt LCTRL>;
)
ZMK_TRI_STATE(selword,
    bindings = <&selword_start>, <&kp RIGHT>, <&selword_end>;
    ignored-key-positions = <RM1>; // LEFT: extend backwards
)

// Select line. First press selects the current line from its first non-blank
// character to the end; each further press extends the selection by one line.
// END before HOME makes HOME land on the indentation in "smart home" editors
// (VS Code, JetBrains) instead of toggling between indentation and column 0.
// Continue also fires on the first press, so start leaves the selection one
// character short (Shift+Left); continue's Shift+Right undoes that on the first
// press and crosses into the next line on later presses, then Shift+End.
ZMK_MACRO(selline_start,
    wait-ms = <10>;
    tap-ms = <20>;
    bindings = <&kp END &kp HOME &kp LS(LEFT)>;
)
ZMK_MACRO(selline_extend,
    wait-ms = <10>;
    tap-ms = <20>;
    bindings = <&kp LS(RIGHT) &kp LS(END)>;
)
ZMK_TRI_STATE(selline,
    bindings = <&selline_start>, <&selline_extend>, <&none>;
)

// Join lines. Joins the next line onto this one, replacing the line break and
// the next line's indentation with one space: go to the next line's first
// non-blank character, select back to the end of this line, type a space.
// Press again to join the following line too.
ZMK_MACRO(joinln,
    wait-ms = <10>;
    tap-ms = <20>;
    bindings = <&kp DOWN &kp END &kp HOME &kp LS(UP) &kp LS(END) &kp SPACE>;
)

// Windows sleep key
ZMK_MACRO(win_sleep,
    wait-ms = <100>;
    tap-ms = <5>;
    bindings = <&kp LG(X) &kp U &kp S>;
)

// Alt-Tab / Ctrl-Tab swappers
ZMK_TRI_STATE(swap,
    bindings = <&kt LALT>, <&kp TAB>, <&kt LALT>;
    ignored-key-positions = <LT2>;
)
ZMK_TRI_STATE(tabswap,
    bindings = <&kt LCTRL>, <&kp TAB>, <&kt LCTRL>;
    ignored-key-positions = <LT2>;
)

// Smart-mouse (urob/zmk-config): the LT3+LT1 combo turns on the MOUSE layer, and it
// stays on until a key outside ignored-key-positions is pressed (that key still fires).
// Ignored: the combo keys, the thumbs (hold for NAV = faster / FN = slower pointer, see
// mouse.dtsi), and every key used on the mouse layer. ignored-layers keeps MOUSE, NAV
// and FN from ending it when they activate.
ZMK_TRI_STATE(smart_mouse,
    bindings = <&tog MOUSE>, <&none>, <&tog MOUSE>;
    ignored-key-positions = <LT3 LT1 LH0 LH1 RT1 RT2 RT3 RM1 RM2 RM3 RB1 RB2 RB3 RH0 RH1>;
    ignored-layers = <MOUSE NAV FN>;
)

// tap: backspace | lshft + tap: delete | rshft + tap: shift-delete | hold: FN layer
ZMK_MOD_MORPH(bs_del,
    bindings = <&kp BSPC>, <&kp DEL>;
    mods = <(MOD_LSFT|MOD_RSFT)>;
    keep-mods = <MOD_RSFT>;
)
ZMK_HOLD_TAP(lt_bspc,
    flavor = "balanced";
    tapping-term-ms = <200>;
    quick-tap-ms = <QUICK_TAP_MS>;
    bindings = <&mo>, <&bs_del>;
)

// tap: space | shift + tap: dot -> space -> sticky shift | hold: NAV layer
ZMK_MACRO(dot_spc,
    wait-ms = <0>;
    tap-ms = <5>;
    bindings = <&kp DOT &kp SPACE &sk LSHFT>;
)
ZMK_MOD_MORPH(spc_morph,
    bindings = <&kp SPACE>, <&dot_spc>;
    mods = <(MOD_LSFT|MOD_RSFT)>;
)
ZMK_HOLD_TAP(lt_spc,
    flavor = "balanced";
    tapping-term-ms = <200>;
    quick-tap-ms = <QUICK_TAP_MS>;
    bindings = <&mo>, <&spc_morph>;
)

// tap: num-word | double-tap: sticky NUM layer | hold: NUM layer
// (zmk-auto-layer's &num_word, via #include <behaviors/num_word.dtsi> above)
#define SMART_NUM &smart_num NUM 0
ZMK_HOLD_TAP(smart_num,
    bindings = <&mo>, <&num_dance>;
    flavor = "balanced";
    tapping-term-ms = <200>;
    quick-tap-ms = <QUICK_TAP_MS>;
)
ZMK_TAP_DANCE(num_dance,
    bindings = <&num_word NUM>, <&sl NUM>;
    tapping-term-ms = <200>;
)

// tap: repeat-last-letter (via zmk-adaptive-key) or sticky-shift | shift + tap: caps-word | hold: shift
#define MAGIC_SHIFT &magic_shift LSHFT 0
ZMK_HOLD_TAP(magic_shift,
    bindings = <&kp>, <&magic_shift_tap>;
    flavor = "balanced";
    tapping-term-ms = <200>;
    quick-tap-ms = <QUICK_TAP_MS>;
)
ZMK_MOD_MORPH(magic_shift_tap,
    bindings = <&shift_repeat>, <&caps_word>;
    mods = <(MOD_LSFT)>;
)
ZMK_ADAPTIVE_KEY(shift_repeat,
    bindings = <&sk LSHFT>;
    repeat {
        trigger-keys = <A B C D E F G H I J K L M N O P Q R S T U V W X Y Z>;
        bindings = <&key_repeat>;
        max-prior-idle-ms = <1200>;
        strict-modifiers;
    };
)

/* Keymap */

// -------------------------------------------------------------------------------------
// |   Q   |   W   |   E   |   R   |   T   |   |   Y   |   U   |   I   |   O   |   P   |
// | A/GUI | S/ALT | D/CTL | F/SFT |   G   |   |   H   | J/SFT | K/CTL | L/ALT | ;/GUI |
// |   Z   |   X   |   C   |   V   |   B   |   |   N   |   M   |   ,   |   .   |   /   |
//                         |SPC/NAV|BSPC/FN|   |  NUM  | MAGIC |
// encoders: left press GUI, turn volume | right press GUI, turn undo/redo
// Home-row mods on the middle row. NUM: tap num-word, hold NUM. MAGIC: tap repeat/sticky shift, hold shift.
ZMK_LAYER(QWERTY,
    &kp Q         &kp W         &kp E         &kp R         &kp T           &kp Y         &kp U         &kp I         &kp O         &kp P
    &hml LGUI A   &hml LALT S   &hml LCTRL D  &hml LSHFT F  &kp G           &kp H         &hmr RSHFT J  &hmr LCTRL K  &hmr LALT L   &hmr LGUI SEMI
    &kp Z         &kp X         &kp C         &kp V         &kp B           &kp N         &kp M         &kp COMMA     &kp DOT       &kp FSLH
                  &lt_spc NAV 0                 &lt_bspc FN 0                 SMART_NUM     MAGIC_SHIFT

    HALCYON_KEYS(&kp RGUI, &kp RGUI) // encoder push buttons: left, right
    , SENSORS                        // encoder rotation: left = volume, right = undo/redo
)

// -------------------------------------------------------------------------------------
// |  UNDO |  REDO | S-TAB |  SWAP | TABSWP|   | SELLN |  BSPC | ENTER |  DEL  |  HOME |
// |  sGUI |  sALT |  sCTL |  sSFT |  PSCR |   | SELWD |  LEFT |  DOWN |   UP  | RIGHT |
// |  MON< |  WIN< |  WIN^ |  WIN> |  MON> |   |  JOIN |  TAB  | PG DN | PG UP |  END  |
//                         |       |       |   | ENTER | CANCEL|
// encoders: left press GUI, turn volume | right press GUI, turn undo/redo
// s = sticky mod. Hold LEFT/RIGHT = Home/End, UP/DOWN = document start/end, BSPC/DEL = delete word.
// SELWD/SELLN: press again (while holding NAV) to extend by a word/line. JOIN: join next line.
ZMK_LAYER(nav,
    &kp U_UND     &kp U_RDO     &kp LS(TAB)   &swap         &tabswap        &selline      NAV_BSPC      &kp ENTER     NAV_DEL       &kp HOME
    &sk LGUI      &sk LALT      &sk LCTRL     &sk LSHFT     &kp U_PSCR      &selword      NAV_LEFT      NAV_DOWN      NAV_UP        NAV_RIGHT
    &kp U_SLFT    &winleft      &winup        &winrght      &kp U_SRGT      &joinln       &kp TAB       &kp PG_DN     &kp PG_UP     &kp END
                  &trans                        &trans                        &kp ENTER     CANCEL

    HALCYON_KEYS(&kp RGUI, &kp RGUI) // encoder push buttons: left, right
    , SENSORS                        // encoder rotation: left = volume, right = undo/redo
)

// -------------------------------------------------------------------------------------
// |       |   7   |   8   |   9   |       |   |       |       |       |       |       |
// | 0/GUI | 4/ALT | 5/CTL | 6/SFT |       |   |       |       |       |       |       |
// |       |   1   |   2   |   3   |       |   |       |       |       |       |       |
//                         |       |       |   |       |       |
// encoders: left press GUI, turn volume | right press GUI, turn undo/redo
ZMK_LAYER(num,
    &trans        &kp N7        &kp N8        &kp N9        &trans          &trans        &trans        &trans        &trans        &trans
    &hml LGUI N0  &hml LALT N4  &hml LCTRL N5 &hml LSHFT N6 &trans          &trans        &trans        &trans        &trans        &trans
    &trans        &kp N1        &kp N2        &kp N3        &trans          &trans        &trans        &trans        &trans        &trans
                  &trans                        &trans                        &trans        &trans

    HALCYON_KEYS(&kp RGUI, &kp RGUI) // encoder push buttons: left, right
    , SENSORS                        // encoder rotation: left = volume, right = undo/redo
)

// -------------------------------------------------------------------------------------
// |  F12  |   F7  |   F8  |   F9  |       |   |       |  PREV |  VOL+ |  NEXT | SLEEP |
// |  F11  |   F4  |   F5  |   F6  |       |   |       | DSK</S| VOL-/C| DSK>/A|       |
// |  F10  |   F1  |   F2  |   F3  |       |   |       |       |       |       |       |
//                         |       |       |   |  MUTE |  PLAY |
// encoders: left press GUI, turn volume | right press MUTE, turn volume
// DSK = previous/next virtual desktop; /S /C /A = shift/ctrl/alt on hold.
ZMK_LAYER(fn,
    &kp F12       &kp F7        &kp F8        &kp F9        &trans          &trans        &kp C_PREV    &kp C_VOL_UP  &kp C_NEXT    &win_sleep
    &kp F11       &kp F4        &kp F5        &kp F6        &trans          &trans        DSK_PREV      VOL_DOWN      DSK_NEXT      &trans
    &kp F10       &kp F1        &kp F2        &kp F3        &trans          &trans        &trans        &trans        &trans        &trans
                  &trans                        &trans                        &kp C_MUTE    &kp C_PP

    HALCYON_KEYS(&kp RGUI, &kp C_MUTE) // encoder push buttons: left, right = mute
    , SENSORS_FN                         // encoder rotation: left = volume, right = volume
)

// -------------------------------------------------------------------------------------
// |  BT 0 |  BT 1 |  BT 2 |  BT 3 |  BT 4 |   |       |       |       |       | STUDIO|
// |  BT-  |  BT+  |       |       |       |   |       |       |       |       |       |
// | BT CLR|       |       |       |       |   |       |       |       |       |  BOOT |
//                         |       |       |   |       |       |
// encoders: left press GUI, turn volume | right press GUI, turn undo/redo
// Active while FN + NUM are held. STUDIO = ZMK Studio unlock, BOOT = bootloader (right half).
ZMK_LAYER(sys,
    &bt BT_SEL 0  &bt BT_SEL 1  &bt BT_SEL 2  &bt BT_SEL 3  &bt BT_SEL 4    &trans        &trans        &trans        &trans        &studio_unlock
    &bt BT_PRV    &bt BT_NXT    &trans        &trans        &trans          &trans        &trans        &trans        &trans        &trans
    &bt BT_CLR    &trans        &trans        &trans        &trans          &trans        &trans        &trans        &trans        &bootloader
                  &trans                        &trans                        &trans        &trans

    HALCYON_KEYS(&kp RGUI, &kp RGUI) // encoder push buttons: left, right
    , SENSORS                        // encoder rotation: left = volume, right = undo/redo
)

// -------------------------------------------------------------------------------------
// |       |       |       |       |       |   |       | WH DN | MS UP | WH UP |       |
// |       |       |       |       |       |   |       | MS LT | MS DN | MS RT |       |
// |       |       |       |       |       |   |       | WH LT | WH DN | WH RT |       |
//                         |       |       |   |  RCLK |  LCLK |
// encoders: left press GUI, turn volume | right press GUI, turn mouse wheel
// Smart-mouse: LT3+LT1 combo turns it on; any key not shown here (except thumbs) turns it off.
ZMK_LAYER(mouse,
    &trans        &trans        &trans        &trans        &trans          &trans        U_WH_D        U_MS_U        U_WH_U        &trans
    &trans        &trans        &trans        &trans        &trans          &trans        U_MS_L        U_MS_D        U_MS_R        &trans
    &trans        &trans        &trans        &trans        &trans          &trans        U_WH_L        U_WH_D        U_WH_R        &trans
                  &trans                        &trans                        &mkp RCLK     &mkp LCLK

    HALCYON_KEYS(&kp RGUI, &kp RGUI) // encoder push buttons: left, right
    , SENSORS_MOUSE                  // encoder rotation: left = volume, right = mouse wheel
)
